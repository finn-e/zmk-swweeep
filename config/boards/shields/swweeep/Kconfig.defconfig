## config/boards/shields/swweeep/Kconfig.defconfig
```kconfig
# Copyright (c) 2022 The ZMK Contributors
# SPDX-License-Identifier: MIT

if SHIELD_SWWEEEP_DONGLE

config ZMK_KEYBOARD_NAME
    default "Fin's Sweep"

config ZMK_SPLIT_ROLE_CENTRAL
    default y

config ZMK_SPLIT_BLE_CENTRAL_PERIPHERALS
    default 2
    
config ZMK_MOUSE
    default y

config ZMK_COMBO_MAX_COMBOS_PER_KEY
    default 9
endif

if SHIELD_SWWEEEP_LEFT || SHIELD_SWWEEEP_RIGHT || SHIELD_SWWEEEP_DONGLE
config ZMK_SPLIT
    default y
endif
```

## config/west.yml
```yaml
manifest:
  remotes:
    - name: zmkfirmware
      url-base: https://github.com/zmkfirmware
    - name: finn-e
      url-base: https://github.com/finn-e
  projects:
    - name: zmk
      remote: zmkfirmware
      revision: main
      import: app/west.yml
    - name: zmk-dongle-screen
      remote: finn-e
      revision: main
  self:
    path: config
```
